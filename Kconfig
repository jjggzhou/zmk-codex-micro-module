## Kconfig
```kconfig
config CODEX_MICRO
    bool "Codex Micro support"
    select ZMK_HID_INDICATORS
    select ZMK_POINTING
    select BT_GATT_AUTO_UPDATE_MTU if ZMK_BLE

if CODEX_MICRO

config CODEX_REPORT_ROUTER
    bool "Codex USB-priority protocol router"
    default y if !ZTEST
    help
      Owns Vendor Report ingress, JSON-RPC dispatch, and automatic USB-priority
      output selection. Ztests enable this explicitly when testing the router.

config CODEX_INPUT_EVENT_QUEUE_DEPTH
    int "Codex input event queue depth"
    default 16
    range 1 32
    help
      Number of validated key and encoder edges owned by the input worker.

config CODEX_TOUCH_QUEUE_DEPTH
    int "Codex touch edge queue depth"
    default 16
    range 4 32
    help
      Number of timestamped touch edges and deadline ticks that can wait for
      the serialized touch state worker. The GPIO callback never blocks.

config CODEX_ANALOG_STICK
    bool "Codex analog-stick input adapter"
    default n
    help
      Converts synchronized relative X/Y events from zmk-analog-input-driver
      into Codex radial notifications. It remains disabled until a board adds
      a codex,analog-stick Devicetree node.

if CODEX_ANALOG_STICK

config CODEX_ANALOG_QUEUE_DEPTH
    int "Codex analog sample queue depth"
    default 8
    range 1 32
    help
      Number of synchronized raw or radial samples that the input callback can
      hand to the analog worker without allocating memory.

config CODEX_ANALOG_MEANINGFUL_DELTA
    int "Default analog meaningful delta (1/10000 full scale)"
    default 100
    range 0 10000
    help
      Used when a codex,analog-stick node omits meaningful-delta. 100 means a
      radial vector movement of 0.01; zero emits every synchronized sample.

config CODEX_ANALOG_REFRESH_INTERVAL_MS
    int "Default analog refresh interval (ms)"
    default 100
    range 1 2147483647
    help
      Used when a codex,analog-stick node omits refresh-interval-ms. A held
      non-center position is re-emitted after this wrap-safe uptime interval.

endif

config CODEX_FIRMWARE_VERSION
    string "Codex compatibility firmware version"
    default "0.4.1"
    help
      Compatibility target reported by sys.version and device.status. The
      value is based on the original unit used for protocol verification.

config ZMK_KEYBOARD_NAME
    string
    default "Codex Micro"

config USB_DEVICE_VID
    default 0x303A

config USB_DEVICE_PID
    default 0x8360

config USB_DEVICE_MANUFACTURER
    default "Work Louder"

config USB_DEVICE_PRODUCT
    default "Codex Micro"

config USB_HID_DEVICE_COUNT
    int
    default 1
    range 1 1

config HID_INTERRUPT_EP_MPS
    int
    default 64
    range 64 64

config USB_HID_REPORTS
    int
    default 6
    range 6 6

config ZMK_HID_KEYBOARD_REPORT_SIZE
    int
    default 6
    range 6 6

config ZMK_HID_CONSUMER_REPORT_SIZE
    int
    default 1
    range 1 1

config BT_L2CAP_TX_MTU
    default 69
    range 69 69

config BT_BUF_ACL_RX_SIZE
    default 73
    range 73 73

config BT_BUF_ACL_TX_SIZE
    default 73
    range 73 73

endif
```

## dts/bindings/input/codex,analog-stick.yaml
```yaml
description: |
  Adapts synchronized relative X/Y input events from badjeff's
  zmk,analog-input driver to Codex radial notifications. The input-device must
  report INPUT_EV_REL/INPUT_REL_X and INPUT_EV_REL/INPUT_REL_Y. An event with
  sync set ends one atomic sample: either axis may be omitted when unchanged,
  so the adapter retains the other axis's latest raw value.

compatible: "codex,analog-stick"

properties:
  input-device:
    type: phandle
    required: true
    description: zmk,analog-input device that produces the paired X/Y events.
  center-x:
    type: int
    required: true
    description: Raw X reading at rest.
  center-y:
    type: int
    required: true
    description: Raw Y reading at rest.
  max-x:
    type: int
    required: true
    description: |
      Positive full-scale raw X reading. It must be strictly greater than
      center-x; the negative full-scale is treated as center-x - (max-x - center-x).
  max-y:
    type: int
    required: true
    description: |
      Positive full-scale raw Y reading. It must be strictly greater than
      center-y; the negative full-scale is treated as center-y - (max-y - center-y).
  dead-zone:
    type: int
    default: 0
    description: Raw counts around both axes' centers that normalize exactly to zero.
  invert-x:
    type: boolean
    description: Reverse the normalized X axis.
  invert-y:
    type: boolean
    description: Reverse the normalized Y axis.
  meaningful-delta:
    type: int
    description: |
      Minimum radial vector change for an immediate notification, expressed in
      1/10000 of full scale (100 is 0.01). Values must be 0 through 10000;
      omitted values use CONFIG_CODEX_ANALOG_MEANINGFUL_DELTA.
  refresh-interval-ms:
    type: int
    description: |
      Maximum time a non-center state may remain unreported. It is a positive
      milliseconds interval (at most INT32_MAX) compared with wrap-safe
      unsigned uptime arithmetic. Omitted values use
      CONFIG_CODEX_ANALOG_REFRESH_INTERVAL_MS.
```

## dts/bindings/lighting/codex,rgb-zones.yaml
```yaml
description: Codex Micro logical RGB zone membership in physical strip order

compatible: "codex,rgb-zones"

properties:
  pixel-count:
    type: int
    required: true
    description: Total physical RGB pixels addressable by the renderer

  keys:
    type: array
    required: true
    description: Physical pixel indices for key backlighting

  ambient:
    type: array
    required: true
    description: Physical pixel indices for ambient underglow

  agent-0:
    type: array
    required: true
  agent-1:
    type: array
    required: true
  agent-2:
    type: array
    required: true
  agent-3:
    type: array
    required: true
  agent-4:
    type: array
    required: true
  agent-5:
    type: array
    required: true
```

## tests/analog_invalid/Kconfig
```kconfig
source "Kconfig.zephyr"

rsource "../../Kconfig"

config ZMK_HID_REPORT_TYPE_HKRO
    bool
    default y

config ZMK_HID_CONSUMER_REPORT_USAGES_FULL
    bool
    default y

config ZMK_HID_INDICATORS
    bool
    default y
```

## tests/descriptor/testcase.yaml
```yaml
tests:
  codex.descriptor:
    platform_allow:
      - native_posix_64
    tags:
      - codex_micro
      - descriptor
```

## tests/framing/testcase.yaml
```yaml
tests:
  codex.framing:
    platform_allow: native_posix_64
    tags:
      - codex
      - framing
```

## tests/input/testcase.yaml
```yaml
tests:
  codex.input:
    platform_allow:
      - native_posix_64
    tags:
      - codex_micro
      - input
```

## tests/integration/router/Kconfig
```kconfig
source "Kconfig.zephyr"

config ZMK_POINTING
    bool
    default y

config ZMK_BLE
    bool
    default n

config ZMK_HID_REPORT_TYPE_HKRO
    bool
    default y

config ZMK_HID_REPORT_TYPE_NKRO
    bool
    default n

config ZMK_HID_CONSUMER_REPORT_USAGES_FULL
    bool
    default y

config ZMK_HID_CONSUMER_REPORT_USAGES_BASIC
    bool
    default n

config ZMK_HID_KEYBOARD_REPORT_SIZE
    int
    default 6

config ZMK_HID_CONSUMER_REPORT_SIZE
    int
    default 1
```

## tests/integration/router/testcase.yaml
```yaml
tests:
  codex.router_integration:
    platform_allow:
      - native_posix_64
    tags:
      - codex_micro
      - router
```

## tests/integration/testcase.yaml
```yaml
tests:
  codex.usb_integration:
    platform_allow:
      - native_posix_64
    tags:
      - codex_micro
      - usb
```

## tests/lighting/testcase.yaml
```yaml
tests:
  codex.lighting:
    platform_allow: native_posix_64
    tags:
      - codex
      - lighting
```

## tests/rpc/testcase.yaml
```yaml
tests:
  codex.rpc:
    platform_allow: native_posix_64
    tags:
      - codex
      - rpc
```

## tests/smoke/testcase.yaml
```yaml
tests:
  codex.smoke:
    platform_allow:
      - native_posix_64
    tags:
      - codex_micro
```
